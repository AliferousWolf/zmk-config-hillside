## config/west.yml
```yaml
manifest:
  remotes:
    - name: zmkfirmware
      url-base: https://github.com/zmkfirmware
  projects:
    - name: zmk
      remote: zmkfirmware
      revision: v0.3 #Use "main" if you want the most up to date version. Also change github workflow yml file. This might break your current code.
      import: app/west.yml
  self:
    path: config
```
